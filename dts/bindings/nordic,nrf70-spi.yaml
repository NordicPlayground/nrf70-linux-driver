## dts/bindings/nordic,nrf70-spi.yaml
```yaml
# Copyright (c) 2023 Nordic Semiconductor ASA
# SPDX-License-Identifier: GPL-2.0
%YAML 1.2
---
$id: http://devicetree.org/schemas/spi/nordic,nrf70-spi.yaml#
$schema: http://devicetree.org/meta-schemas/core.yaml#

title: Nordic nRF70 series Wi-Fi SoC

allOf:
  - $ref: spi-controller.yaml
  - $ref: nordic,nrf70-spi.yaml

maintainers:
  - Ajay Parida <ajay.parida@nordicsemi.no>


description: This is a representation of the nRF70 series Wi-Fi evaluation kit
  (PCA10090) and nRF70 series Wi-Fi module (PCA10095) SPI controller.

properties:
  compatible:
    enum:
      - nordic,nrf70-spi
```

## dts/bindings/nordic,nrf70.yaml
```yaml
# Copyright (c) 2023 Nordic Semiconductor ASA
# SPDX-License-Identifier: GPL-2.0
%YAML 1.2
---
$id: http://devicetree.org/schemas/spi/nordic,nrf70.yaml#
$schema: http://devicetree.org/meta-schemas/core.yaml#

title: Nordic nRF70 series Wi-Fi SoC common bindings

maintainers:
  - Ajay Parida <ajay.parida@nordicsemi.no>

properties:
  iovdd-ctrl-gpios:
    type: phandle-array
    required: true
    description: |
            GPIO of the SOC controlling IO VDD Control pin of the nRF70
  bucken-gpios:
    type: phandle-array
    required: true
    description: |
            GPIO of the SOC controlling BUCK_EN pin of the nRF70
  host-irq-gpios:
    type: phandle-array
    required: true
    description: |
            GPIO of the SOC controlling the HOST IRQ pin of the nRF70
```

## west.yml
```yaml
# Copyright (c) 2021 Nordic Semiconductor ASA
# SPDX-License-Identifier: Apache-2.0

manifest:
  remotes:
    - name: ncs
      url-base: https://github.com/nrfconnect

  projects:
    # TODO: Once west supports sparse checkout, we should use it here.
    - name: nrfxlib
      remote: ncs
      repo-path: sdk-nrfxlib
      revision: 2fe3e8248e16a52cf530358815d19617cb96c1d1
```
